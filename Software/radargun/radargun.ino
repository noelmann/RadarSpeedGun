#include <FreqMeasure.h>
#include <PCM.h>
#include <LiquidCrystal_I2C.h>

LiquidCrystal_I2C lcd(0x27,16,2);

const unsigned char sample[] PROGMEM = {
  129, 127, 126, 127, 129, 128, 127, 126, 128, 129, 128, 127,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 125,  
};

const double conv = 0.277777777778;

double sum = 0;
int count = 0;

int cycleCount = 0;
 
double f;   // Frequenz
double v;   // Geschwindigkeit

void setup() {
  // put your setup code here, to run once:
Serial.begin(9600);
lcd.init();
lcd.backlight();
lcd.print("test");
Serial.println("test");
delay(1000);
pinMode(8,INPUT);
pinMode(4,OUTPUT);
FreqMeasure.begin();
}

void loop()
   {
    Serial.println(cycleCount);
    if(cycleCount >= 200)
    {
      lcd.noBacklight();
      cycleCount = 0;
    }
    else
    {
      cycleCount++;
    }
    
    //delay(10);
    if (FreqMeasure.available())
       {
        // average the readings together

       
        
        double freq = FreqMeasure.read();

        if(freq>50.29)
        {
        sum += freq;
        count = count + 1;
        }
    
        if (count >= 10)
           {
            
            f = FreqMeasure.countToFrequency(sum / count);
            
            v = (f / 44)*conv;       // conversion from frequency to kilometers per hour
            
            
            if(f>50.30)
            {
            cycleCount = 0;
            lcd.clear();
            lcd.backlight();
            Serial.print("v = ");
            Serial.print(v,1);

            Serial.println(" m/s");
            Serial.println((String)f+ " hz");
            
            lcd.setCursor(0,0);
            lcd.print((String)v + " m/s");
            lcd.setCursor(0,1);
            lcd.print((String)f+ " hz");
            //startPlayback(sample, sizeof(sample));
            //delay(2000);
            //stopPlayback();
            //playSound();
            digitalWrite(4,HIGH);
            delay(50);
            digitalWrite(4,LOW);   
            }
                     
            sum = 0;
            count = 0;
            delay(50);
            
           }
       }
   }

   void playSound()
   {
    delay(1000);
    startPlayback(sample,sizeof(sample));
    delay(1000);
    stopPlayback();
    delay(1000);
   }
